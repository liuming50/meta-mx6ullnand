## conf/layer.conf
```bitbake
# We have a conf and classes directory, add to BBPATH
BBPATH .= ":${LAYERDIR}"

# We have recipes-* directories, add to BBFILES
BBFILES += "${LAYERDIR}/recipes-*/*/*.bb \
            ${LAYERDIR}/recipes-*/*/*.bbappend"

BBFILE_COLLECTIONS += "meta-mx6ullnand"
BBFILE_PATTERN_meta-mx6ullnand = "^${LAYERDIR}/"
BBFILE_PRIORITY_meta-mx6ullnand = "6"


LAYERDEPENDS_meta-mx6ullnand = "core"
LAYERSERIES_COMPAT_meta-mx6ullnand = "scarthgap"
```

## conf/machine/include/imx6ullevk.inc
```bitbake
# Set the U-Boot configuration
UBOOT_CONFIG = "nand"

# Add initramfs support
INITRAMFS_IMAGE = "core-image-initramfs-boot"
INITRAMFS_IMAGE_BUNDLE = "1"
INITRAMFS_FSTYPES = "cpio.gz"

ACCEPT_FSL_EULA = "1"
```

## conf/machine/mx6ull-c-q.conf
```bitbake
require conf/machine/imx6ullevk.conf
MACHINEOVERRIDES =. "imx6ullevk:"
MACHINE_FEATURES += "optee bcm4339 bcm43455"

# Set the U-Boot configuration
UBOOT_CONFIG = "nand"
UBOOT_CONFIG[nand] = "mx6ull_14x14_evk_nand_config,ubifs"


# Add initramfs support
INITRAMFS_IMAGE_NAME = "core-image-initramfs"
INITRAMFS_IMAGE_BUNDLE = "1"
INITRAMFS_MAXSIZE = "921600"

IMAGE_FSTYPES = "cpio.gz"

PREFERRED_PROVIDER_virtual/bootloader = "u-boot-imx"
PREFERRED_PROVIDER_virtual/kernel = "linux-imx"


ACCEPT_FSL_EULA = "1"
```

## conf/machine/mx6ull-custom-nand.conf
```bitbake
require conf/machine/imx6ullevk.conf
MACHINEOVERRIDES =. "imx6ullevk:"

# Set the U-Boot configuration
UBOOT_CONFIG = "nand"
UBOOT_CONFIG[nand] = "mx6ull_14x14_evk_nand_config"


# Add initramfs support
INITRAMFS_IMAGE_NAME = "core-image-initramfs"
INITRAMFS_IMAGE_BUNDLE = "1"

IMAGE_FSTYPES += "cpio.gz"

PREFERRED_PROVIDER_virtual/bootloader = "u-boot-imx"
PREFERRED_PROVIDER_virtual/kernel = "linux-fslc"


ACCEPT_FSL_EULA = "1"
```

## recipes-kernel/linux/linux-imx/files/custom-defconfig
```kconfig
CONFIG_BLK_DEV_INITRD=y
CONFIG_INITRAMFS_SOURCE=""
CONFIG_INITRAMFS_ROOT_UID=0
CONFIG_INITRAMFS_ROOT_GID=0
CONFIG_RD_GZIP=y
CONFIG_RD_BZIP2=y
CONFIG_RD_LZMA=y
CONFIG_RD_XZ=y
CONFIG_RD_LZO=y
CONFIG_RD_LZ4=y

CONFIG_MTD=y
CONFIG_MTD_NAND=y
CONFIG_MTD_NAND_ECC=y
CONFIG_MTD_NAND_BBT=y
CONFIG_UBIFS_FS=y
```
